## examples/image_test/main/Kconfig.projbuild
```kconfig
menu "Example Configuration"

    config AP_SSID
        string "AP SSID"
        default "AP_SSID"
        help
            Access point SSID.

    config AP_PASSWD
        string "AP password"
        default "AP_PASSWD"
        help
            Access point password.

    config MQTT_BROKER_URI
        string "MQTT broker URI"
        help
            MQTT broker URI.

    config MQTT_USERNAME
        string "MQTT username"
        help
            MQTT username for authentication.

    config MQTT_PASSWORD
        string "MQTT password"
        help
            MQTT password for authentication.

endmenu
```

## examples/perf/sdkconfig.defaults
```kconfig
CONFIG_LWIP_L2_TO_L3_COPY=y
CONFIG_LWIP_IP_FORWARD=y
CONFIG_LWIP_IPV4_NAPT=y

# needed for ESP-WIFI-MESH. TCP packets have 54 byte overhead, 1472 is max payload size for ESP-WIFI-MESH
CONFIG_LWIP_TCP_MSS=1418
```

## examples/sensor_demo/main/Kconfig.projbuild
```kconfig
menu "Example Configuration"

    config EXAMPLE_ROUTER_SSID
        string "Router SSID"
        default "myssid"
        help
            SSID (network name) for the example to connect to.

    config EXAMPLE_ROUTER_PASSWORD
        string "Router Password"
        default "mypassword"
        help
            Router password for the example to use.

    config EXAMPLE_MQTT_BROKER_URI
        string "MQTT Broker URI"
        default "mqtt://test.mosquitto.org:1883"
        help
            URI of the MQTT broker to connect to.

endmenu
```
