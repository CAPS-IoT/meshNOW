## meshnow/Kconfig.projbuild
```kconfig
menu "MeshNOW Customization"

    config MAX_CHILDREN
        int "Maximum number of children"
        default 5
        help
            Determines the maximum number of children that a node can have.
            If a node has reached the maximum number of children, it will not accept new children.
            Lowering this value can save memory, but complicate node deployment.

    config SEARCH_PROBE_INTERVAL
        int "Search probe interval (ms)"
        default 50
        help
            Time in milliseconds until the next search probe is sent during the search phase.
            A smaller value will result in a faster connection, but will also increase network congestion and power consumption.

    config PROBES_PER_CHANNEL
        int "Number of search probes per channel"
        default 3
        help
            During the search phase, the node performs an all-channel scan as the home channel of any potential parent node is unknown.
            This value determines the number of search probes that are sent on each channel.
            A smaller value may result in failing to accept a connection because the channel is switched before a reply is received.
            A larger value may increase the time it takes to connect as the node stays longer on dead channels.

    config FIRST_PARENT_WAIT
        int "First parent wait time (ms)"
        default 3000
        help
            During the search phase, after a first potential parent was found, the node keeps searching for more parents in case an even better parent is found.
            This value determines the time in milliseconds that the node keeps searching for more parents after the first one was found.
            Set to 0 to disable this feature.

    config MAX_PARENTS_TO_CONSIDER
        int "Maximum number of parents to consider during search"
        default 5
        help
            During the search phase, the node keeps track of only a few parents at a time to save memory and speed up the connection process.
            This value determines the maximum number of parents that the node keeps track of. If a better parent is found, the node will replace the worst parent it is tracking.

    config CONNECT_TIMEOUT
        int "Connection timeout (ms)"
        default 3000
        help
            During the connect phase, the node sends a connect request to the best parent and waits for a reply.
            This value determines the time in milliseconds that the node waits for a reply before trying to connect to the next best parent.

    config STATUS_SEND_INTERVAL
        int "Status send interval (ms)"
        default 500
        help
            A node sends a special status beacon to each of its neighbors at regular intervals.
            This value determines the time in milliseconds between two status beacons.
            The value should best be smaller than CONFIG_KEEP_ALIVE_TIMEOUT to prevent false disconnects.

    config KEEP_ALIVE_TIMEOUT
        int "Keep alive timeout (ms)"
        default 3000
        help
            A node considers a neighbor to be disconnected if it has not received a status beacon from it for a certain time.
            This value determines the time in milliseconds after which a neighbor is considered to be disconnected.
            The value should best be larger than CONFIG_STATUS_SEND_INTERVAL to prevent false disconnects.

    config ROOT_UNREACHABLE_TIMEOUT
        int "Root unreachable timeout (ms)"
        default 10000
        help
            If a node disconnects from its parent, all its (indirect) children will stay connected.
            After this timeout value in milliseconds, the nodes will disconnect and search for new parents as they cannot reach the root node anymore.

    config FRAGMENT_TIMEOUT
        int "Fragment timeout (ms)"
        default 3000
        help
            TCP/IP packets need to be fragmented by MeshNOW to fit into the ESP-NOW payload size limit.
            This value determines the time in milliseconds that MeshNOW waits for another fragment of the same TCP/IP packet to be received before completely discarding it.
            A smaller value will lead to less memory usage, but may result in higher retransmission counts and therefore higher network congestion.

    config STATIC_DNS_ADDR
        hex "Static DNS address"
        default 0x01010101
        help
            The IP address of the DNS server that is used for DNS lookups. This value is encoded as a 4-byte hex value.

    config RECEIVER_PRIORITY_QUEUE_LEVELS
        int "receiver priority queue levels number"
        default 1
        help
            Specify the number of priority levels used in the receiver. If set to 1, then all messages will have the same priority level.
            Othewise, the level of priority of different types of messages can help processing important messages sooner than less important
            ones. The priority level of each kind of message can also be set. 
    
    config MESSAGES_PER_PRIORITY_LEVEL
        int "messages per priority level"
        default 2
        help
            This parameter specify the maximum number of messages with priority level i that will processed one after the other until some 
            message with lower priority is also processed. If MESSAGES_PER_PRIORITY_LEVEL = n, then, for a priority level i, this number 
            will be (RECEIVER_PRIORITY_QUEUE_LEVELS - i)*n. Hence, the higher the level of priority, the lower this number. This allows 
            to make less important messages be processed even if the higher levels are used, and thus ensures some fairness.
    
    config STATUS_MESSAGE_LEVEL
        int "status message level"
        default 1
        help 
            Priority level of status messages.
        
    config SEARCH_PROBE_MESSAGE_LEVEL
        int "search probe message level"
        default 1
        help 
            Priority level of search probe messages.

    config SEARCH_REPLY_MESSAGE_LEVEL
        int "search reply message level"
        default 1
        help 
            Priority level of search reply messages.

    config CONNECT_REQUEST_MESSAGE_LEVEL
        int "connect request message level"
        default 1
        help 
            Priority level of connecty request messages.

    config CONNECT_OK_MESSAGE_LEVEL
    int "connect ok message level"
    default 1
    help
        Priority level of connect ok messages.

    config ROUTING_TABLE_ADD_MESSAGE_LEVEL
        int "routing table add message level"
        default 1
        help
            Priority level of routing table add messages.

    config ROUTING_TABLE_REMOVE_MESSAGE_LEVEL
        int "routing table remove message level"
        default 1
        help
            Priority level of routing table remove messages.

    config ROOT_UNREACHABLE_MESSAGE_LEVEL
        int "root unreachable message level"
        default 1
        help
            Priority level of root unreachable messages.

    config ROOT_REACHABLE_MESSAGE_LEVEL
        int "root reachable message level"
        default 1
        help
            Priority level of root reachable messages.

    config DATA_FRAGMENT_MESSAGE_LEVEL
        int "data fragment message level"
        default 1
        help
            Priority level of data fragment messages.

    config CUSTOM_DATA_MESSAGE_LEVEL
        int "custom data message level"
        default 1
        help
            Priority level of custom data messages.

endmenu
```
